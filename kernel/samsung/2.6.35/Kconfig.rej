## kernel/samsung/2.6.35/Kconfig.rej
```kconfig
--- Kconfig	2010-11-17 00:33:14.461761002 +0100
+++ Kconfig	2010-10-20 22:30:22.000000000 +0200
@@ -652,18 +652,6 @@
 
 endif # CGROUPS
 
-config SCHED_AUTOGROUP
-	bool "Automatic process group scheduling"
-	select CGROUPS
-	select CGROUP_SCHED
-	select FAIR_GROUP_SCHED
-	help
-	  This option optimizes the scheduler for common desktop workloads by
-	  automatically creating and populating task groups.  This separation
-	  of workloads isolates aggressive CPU burners (like build jobs) from
-	  desktop applications.  Task group autogeneration is currently based
-	  upon task tty association.
-
 config MM_OWNER
 	bool
 
```
